/*
 * MYZR Technology Co.,Ltd
 * http://www.myzr.com.cn
 * Tang Bin <tangb@myzr.com.cn>
 */

/dts-v1/;
#include "imx6dl.dtsi"
#include "myimx6ek336.dtsi"
#include "myimx6us.dtsi"

/ {
	model = "MYZR i.MX6 Evaluation Kit (MY-IMX6-EK336-6S-512M)";
	compatible = "myzr,myimx6", "myzr,myimx6u", "myzr,myimx6cb336", "myzr,myimx6ek336", "fsl,imx6dl";
};
