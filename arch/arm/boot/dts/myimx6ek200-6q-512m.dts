/*
 * MYZR Technology Co.,Ltd
 * http://www.myzr.com.cn
 * Tang Bin <tangb@myzr.com.cn>
 */

/dts-v1/;
#include "imx6q.dtsi"
#include "myimx6ek200.dtsi"
#include "myimx6q.dtsi"

/ {
	model = "MYZR i.MX6 Evaluation Kit (MY-IMX6-EK200-6Q-512M)";
	compatible = "myzr,myimx6", "myzr,myimx6q", "myzr,myimx6cb200", "myzr,myimx6ek200", "fsl,imx6q";
};
